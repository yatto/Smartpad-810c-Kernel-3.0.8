## arch/arm/mach-rk29/Kconfig
```kconfig
if ARCH_RK29
config VENDOR_YF
bool "YF vendor"
default n

choice
	prompt "Select Board Type"
	depends on ARCH_RK29
	default MACH_RK29SDK

config MACH_RK29SDK
	depends on ARCH_RK29
	bool "ROCKCHIP Board Rk29 For Sdk"
        help
	  Support for the ROCKCHIP Board For Rk29 Sdk.

config MACH_RK29SDK_DDR3
        depends on ARCH_RK29
        bool "ROCKCHIP Board Rk29 For DDR3 SDK"
        help
          Support for the ROCKCHIP Board For Rk29 Sdk.

config MACH_RK29WINACCORD
	depends on ARCH_RK29
	bool "ROCKCHIP Board Rk29 For Winaccord"
        help
	  Support for the ROCKCHIP Board For Rk29 Winaccord.

config MACH_RK29_K97
        depends on ARCH_RK29
        bool "ROCKCHIP Board Rk29 For K97"
        help
          Support for the ROCKCHIP Board For Rk29 K97.

config MACH_RK29FIH
	depends on ARCH_RK29
	bool "ROCKCHIP Board Rk29 For FIH"
        help
	  Support for the ROCKCHIP Board For Rk29 FIH.

config MACH_RK29_MALATA
	depends on ARCH_RK29
	bool "ROCKCHIP Board Rk29 For Malata"
        help
	  Support for the ROCKCHIP Board For Rk29 Malata.

config MACH_M900HW
	depends on ARCH_RK29
	bool "ROCKCHIP Board Rk29 For M900HC"
        help
	  Support for the ROCKCHIP Board For M900HC.

config MACH_M900HWZ
	depends on ARCH_RK29
	bool "ROCKCHIP Board Rk29 For M900HC"
        help
	  Support for the ROCKCHIP Board For M900HC.



config MACH_M900HC
	depends on ARCH_RK29
	bool "ROCKCHIP Board Rk29 For M900HC"
        help
	  Support for the ROCKCHIP Board For M900HC.

config MACH_A8
	depends on ARCH_RK29
	bool "ROCKCHIP Board Rk29 For A80HT"
        help
	  Support for the ROCKCHIP Board For A80HT.

config MACH_M907HC
	depends on ARCH_RK29
	bool "ROCKCHIP Board Rk29 For M907HC"
        help
	  Support for the ROCKCHIP Board For M907HC.

config MACH_M907HD
	depends on ARCH_RK29
	bool "ROCKCHIP Board Rk29 For M907HD"
        help
	  Support for the ROCKCHIP Board For M907HD.


config MACH_M726
	depends on ARCH_RK29
	bool "ROCKCHIP Board Rk29 For M726HC"
        help
	  Support for the ROCKCHIP Board For M726HC.

config MACH_M752HC
	depends on ARCH_RK29
	bool "ROCKCHIP Board Rk29 For M752HC"
        help
	  Support for the ROCKCHIP Board For M752HC.

config MACH_M752HCF
	depends on ARCH_RK29
	bool "ROCKCHIP Board Rk29 For M752HC"
        help
	  Support for the ROCKCHIP Board For M752HC.


config MACH_M752HCX
	depends on ARCH_RK29
	bool "ROCKCHIP Board Rk29 For M752HC"
        help
	  Support for the ROCKCHIP Board For M752HC.


config MACH_M722HC
	depends on ARCH_RK29
	bool "ROCKCHIP Board Rk29 For M722HC"
        help
	  Support for the ROCKCHIP Board For M722HC.

config MACH_M805HC
	depends on ARCH_RK29
	bool "ROCKCHIP Board Rk29 For M805HC"
        help
	  Support for the ROCKCHIP Board For M805HC.

config MACH_M815HC
	depends on ARCH_RK29
	bool "ROCKCHIP Board Rk29 For M805HC"
        help
	  Support for the ROCKCHIP Board For M805HC.


config MACH_M805HCZ
	depends on ARCH_RK29
	bool "ROCKCHIP Board Rk29 For M805HCZ"
        help
	  Support for the ROCKCHIP Board For M805HC.

config MACH_M805HCX
	depends on ARCH_RK29
	bool "ROCKCHIP Board Rk29 For M805HCX"
        help
	  Support for the ROCKCHIP Board For M805HC.

config MACH_M805HD
	depends on ARCH_RK29
	bool "ROCKCHIP Board Rk29 For M805HD"
        help
	  Support for the ROCKCHIP Board For M805HD.

config MACH_M816HC
	depends on ARCH_RK29
	bool "ROCKCHIP Board Rk29 For M816HC"
        help
	  Support for the ROCKCHIP Board For M816HC.

config MACH_M816HD
	depends on ARCH_RK29
	bool "ROCKCHIP Board Rk29 For M816HC"
        help
	  Support for the ROCKCHIP Board For M816HC.


config MACH_M732HC
	depends on ARCH_RK29
	bool "ROCKCHIP Board Rk29 For M732HC"
        help
	  Support for the ROCKCHIP Board For M732HC.

config MACH_M732HCN
	depends on ARCH_RK29
	bool "ROCKCHIP Board Rk29 For M732HCN"
        help
	  Support for the ROCKCHIP Board For M732HCN.

config MACH_A70HT3N
	depends on ARCH_RK29
	bool "ROCKCHIP Board Rk29 For A70HT3N"
        help
	  Support for the ROCKCHIP Board For A70HT3N.

config MACH_A80HTN
	depends on ARCH_RK29
	bool "ROCKCHIP Board Rk29 For A80HTN"
        help
	  Support for the ROCKCHIP Board For A80HTN.

config MACH_M727HC
	depends on ARCH_RK29
	bool "ROCKCHIP Board Rk29 For M727HC"
        help
	  Support for the ROCKCHIP Board For M727HC.

config MACH_M727HCF
	depends on ARCH_RK29
	bool "ROCKCHIP Board Rk29 For M727HC"
        help
	  Support for the ROCKCHIP Board For M727HC.


config MACH_M727HD
	depends on ARCH_RK29
	bool "ROCKCHIP Board Rk29 For M727HD"
        help
	  Support for the ROCKCHIP Board For M727HD.

config MACH_M723HR
	depends on ARCH_RK29
	bool "ROCKCHIP Board Rk29 For M723HR"
        help
	  Support for the ROCKCHIP Board For M723HR.


config MACH_M712HC
	depends on ARCH_RK29
	bool "ROCKCHIP Board Rk29 For M712HC"
        help
	  Support for the ROCKCHIP Board For M712HC.

config MACH_M712HCX
	depends on ARCH_RK29
	bool "ROCKCHIP Board Rk29 For M712HCX"
        help
	  Support for the ROCKCHIP Board For M712HCX.

config MACH_M712HCZ
	depends on ARCH_RK29
	bool "ROCKCHIP Board Rk29 For M712HCZ"
        help
	  Support for the ROCKCHIP Board For M712HZ.


config MACH_M719HC
	depends on ARCH_RK29
	bool "ROCKCHIP Board Rk29 For M719HC"
        help
	  Support for the ROCKCHIP Board For M719HC.

config MACH_M1005HD
	depends on ARCH_RK29
	bool "ROCKCHIP Board Rk29 For M1005HD"
        help
	  Support for the ROCKCHIP Board For M1005HD.
config MACH_M1006HD
	depends on ARCH_RK29
	bool "ROCKCHIP Board Rk29 For M1006HD"
        help
	  Support for the ROCKCHIP Board For M1006HD.
config MACH_M1007HD
	depends on ARCH_RK29
	bool "ROCKCHIP Board Rk29 For M1007HD"
        help
	  Support for the ROCKCHIP Board For M1007HD.



config MACH_M1005HN
	depends on ARCH_RK29
	bool "ROCKCHIP Board Rk29 For M1005HN"
        help
	  Support for the ROCKCHIP Board For M1005HN.

config MACH_M1005HNW
	depends on ARCH_RK29
	bool "ROCKCHIP Board Rk29 For M1005HNW"
        help
	  Support for the ROCKCHIP Board For M1005HNW.

config MACH_M813HC
	depends on ARCH_RK29
	bool "ROCKCHIP Board Rk29 For M813HC"
        help
	  Support for the ROCKCHIP Board For M813HC.

config MACH_M813HD
	depends on ARCH_RK29
	bool "ROCKCHIP Board Rk29 For M813HD"
        help
	  Support for the ROCKCHIP Board For M813HD.

config MACH_M803HC
	depends on ARCH_RK29
	bool "ROCKCHIP Board Rk29 For M803HC"
        help
	  Support for the ROCKCHIP Board For M803HC.

config MACH_M803HD
	depends on ARCH_RK29
	bool "ROCKCHIP Board Rk29 For M803HD"
        help
	  Support for the ROCKCHIP Board For M803HD.

config MACH_M908HWZ
	depends on ARCH_RK29
	bool "ROCKCHIP Board Rk29 For M908HW"
        help
	  Support for the ROCKCHIP Board For M908HW.


config MACH_M908HW
	depends on ARCH_RK29
	bool "ROCKCHIP Board Rk29 For M908HW"
        help
	  Support for the ROCKCHIP Board For M908HW.

config MACH_M908HD
	depends on ARCH_RK29
	bool "ROCKCHIP Board Rk29 For M908HD"
        help
	  Support for the ROCKCHIP Board For M908HD.

config MACH_M908HC
	depends on ARCH_RK29
	bool "ROCKCHIP Board Rk29 For M908HC"
        help
	  Support for the ROCKCHIP Board For M908HC.



config MACH_RK29_PHONESDK
	depends on ARCH_RK29
	bool "ROCKCHIP Board Rk29 For Phone Sdk"
        help
	  Support for the ROCKCHIP Board For Rk29 Phone Sdk.

config MACH_RK29_A22
	depends on ARCH_RK29
	bool "ROCKCHIP Board Rk29 For A22"
        help
	  Support for the ROCKCHIP Board For A22.

config MACH_RK29_TD8801_V2
	depends on ARCH_RK29
	bool "ROCKCHIP Board Rk29 For TD8801_v2"
        help
	  Support for the ROCKCHIP Board For TD8801_v2.

config MACH_RK29_PHONEPADSDK
	depends on ARCH_RK29
	bool "ROCKCHIP Board Rk29 For Phone Pad Sdk"
        help
	  Support for the ROCKCHIP Board For Rk29 Phone Pad Sdk.
	  
config MACH_RK29_newton
		depends on ARCH_RK29
		bool "ROCKCHIP Board Rk29 For project newton"
		help
		  Support for the ROCKCHIP Board For project newton.

config MACH_RK29_PHONE_Z5
	depends on ARCH_RK29
	bool "ROCKCHIP Board Rk29 For Z5"
        help
	  Support for the ROCKCHIP Board For Z5.
		  
config MACH_RK29_P91
	depends on ARCH_RK29
	bool "ROCKCHIP Board Rk29 For P91"
        help
	  Support for the ROCKCHIP Board For Rk29 P91.
	  
endchoice

config RK29_NEWTON_CLOCK
	depends on MACH_RK29_newton
	bool "enable newton 1.2G cpu clock support"
	help
	  support for newton 1.2G cpu clock.

choice DDR_TYPE
	prompt "DDR Memory Type"
	default DDR_TYPE_DDR3_DEFAULT 

config DDR_TYPE_DDRII
	bool "DDRII"
	help
	  Support for DDRII memory

config DDR_TYPE_LPDDR
	bool "mobile DDR"
	help
	  Support for mobile DDR, MCP device

config DDR_TYPE_DDR3_800D
	bool "DDR3-800 5-5-5"

config DDR_TYPE_DDR3_800E
	bool "DDR3-800 6-6-6"

config DDR_TYPE_DDR3_1066E
	bool "DDR3-1066 6-6-6"

config DDR_TYPE_DDR3_1066F
	bool "DDR3-1066 7-7-7"

config DDR_TYPE_DDR3_1066G
	bool "DDR3-1066 8-8-8"

config DDR_TYPE_DDR3_1333F
	bool "DDR3-1333 7-7-7"

config DDR_TYPE_DDR3_1333G
	bool "DDR3-1333 8-8-8"

config DDR_TYPE_DDR3_1333H
	bool "DDR3-1333 9-9-9"

config DDR_TYPE_DDR3_1333J
	bool "DDR3-1333 10-10-10"

config DDR_TYPE_DDR3_1600G
	bool "DDR3-1600 8-8-8"

config DDR_TYPE_DDR3_1600H
	bool "DDR3-1600 9-9-9"

config DDR_TYPE_DDR3_1600J
	bool "DDR3-1600 10-10-10"

config DDR_TYPE_DDR3_1600K
	bool "DDR3-1600 11-11-11"

config DDR_TYPE_DDR3_1866J
	bool "DDR3-1866 10-10-10"

config DDR_TYPE_DDR3_1866K
	bool "DDR3-1866 11-11-11"

config DDR_TYPE_DDR3_1866L
	bool "DDR3-1866 12-12-12"

config DDR_TYPE_DDR3_1866M
	bool "DDR3-1866 13-13-13"

config DDR_TYPE_DDR3_2133K
	bool "DDR3-2133 11-11-11"

config DDR_TYPE_DDR3_2133L
	bool "DDR3-2133 12-12-12"

config DDR_TYPE_DDR3_2133M
	bool "DDR3-2133 13-13-13"

config DDR_TYPE_DDR3_2133N
	bool "DDR3-2133 14-14-14"

config DDR_TYPE_DDR3_DEFAULT
	bool "DDR3 (Type default)"

endchoice

config RK29_MEM_SIZE_M
	int "DDR Memory size (in MB)"
	default 512

config DDR_SDRAM_FREQ
	int "DDR SDRAM frequence (in MHz)"
	default 400

config DDR_FREQ
	bool "Enable DDR frequency scaling"

config DDR_RECONFIG
	bool "Enable dynamic DDR reconfiguration (EXPERIMENTAL)"

config WIFI_CONTROL_FUNC
        bool "Enable WiFi control function abstraction"
        help
          Enables Power/Reset/Carddetect function abstraction

menu "RK29 VPU (Video Processing Unit) support"

config RK29_VPU
	bool "VPU service driver in kernel"
	depends on ARCH_RK29
	default y

config RK29_VPU_DEBUG
	bool "RK29 VPU debugging"
        depends on RK29_VPU != n
        help
          This is an option for the developers; most people should
          say N here.  This enables RK29 VPU driver debugging.

endmenu

config RK29_JTAG
	bool "Enable JTAG support (debug only)"
	help
	  This is an option for SDK board. Always enable JTAG clock,
	  but consumes more power.

config RK29_LAST_LOG
	bool "Save the last kernel log on /proc/last_log"
	depends on DEBUG_KERNEL && PRINTK
	default y
	help
	  It is only intended for debugging.

menu "support for RK29 power manage "
config RK29_WORKING_POWER_MANAGEMENT
	bool "Support power saving in working"
	default n
	help 
	  a series of measures to reduce working power

config RK29_CLK_SWITCH_TO_32K
	bool "Support clock switch to 32.768k"
	default n

config RK29_GPIO_SUSPEND
	bool "Support gpio suspend"
	default n

config RK29_NEON_POWERDOMAIN_SET
	bool "Support neon powerdomain on and off"
	default n

config RK29_SPI_INSRAM
	tristate "Support spi control interface"
	depends on REGULATOR_WM831X
	default ns
config RK29_I2C_INSRAM
	tristate "Support i2c control interface"
	depends on REGULATOR_ACT8891
	default ns
config RK29_PWM_INSRAM
	tristate "Support pwm control interface"
	depends on RK29_PWM_REGULATOR
	default y
endmenu


endif
```

## drivers/input/hwmon/Kconfig
```kconfig
#
# gsensor drivers configuration
#

menuconfig FSC_SENSOR_DEVICE
bool "freescale  sensors device support"
default n	

if FSC_SENSOR_DEVICE

config MXC_MMA8451
tristate "MMA8451 device driver"
depends on I2C && SYSFS
default y

config GS_MMA8452
tristate "MMA8452 device driver"
depends on I2C && SYSFS
default n


config MXC_MMA_POSITION
int "MMA845x Accelerate Sensor Position Setting"
depends on MXC_MMA8451
default "0"

config SENSORS_MAG3110
tristate "Freescale MAG3110 e-compass sensor"
depends on I2C && SYSFS

config SENSORS_MAG_POSITION
int "MAG3110 Magnetic Sensor Position Setting"
depends on SENSORS_MAG3110
default "0"

config MXC_MPL3115
tristate "MPL3115 pressure device driver"
depends on I2C
default n

endif
```

## drivers/net/wireless/rtl8192c.fac/Kconfig
```kconfig
config RTL8192CU_FAC
	tristate "Realtek 8192C USB WiFi (Factory only)"
	depends on USB
	select WIRELESS_EXT
	select WEXT_PRIV
	select IEEE80211
	---help---
	  Help message of RTL8192CU
```
